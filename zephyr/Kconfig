## zephyr/Kconfig
```kconfig
choice BTREEFY_RUNNER
    prompt "BTreeFy Runner"
    default BTREEFY_RUNNER_POSIX

config BTREEFY_RUNNER_POSIX
    bool "POSIX runner"
    help
        Use the POSIX-based runner (pthreads, mutex, cond_var).
        Suitable for native_posix and Linux-based targets.

config BTREEFY_RUNNER_ZEPHYR
    bool "Zephyr runner"
    select EVENTS
    help
        Use the Zephyr k_event-based runner.
        Suitable for Zephyr RTOS targets.

endchoice

config BTREEFY_RUNNER
    string
    default "POSIX" if BTREEFY_RUNNER_POSIX
    default "ZEPHYR" if BTREEFY_RUNNER_ZEPHYR
```
